## examples/basic/sdkconfig.defaults
```kconfig
CONFIG_SPIRAM=y
CONFIG_SPIRAM_MODE_QUAD=y
CONFIG_SPIRAM_SPEED_80M=y
CONFIG_SPIRAM_USE_CAPS_ALLOC=y
CONFIG_SPIRAM_TRY_ALLOCATE_WIFI_LWIP=y
CONFIG_SPIRAM_IGNORE_NOTFOUND=y

CONFIG_BLE_SRV_ENABLED=y
CONFIG_BLE_SRV_ADV_NAME_PREFIX="BLE-SRV"
CONFIG_BLE_SRV_WIFI_ENABLED=y
CONFIG_BLE_SRV_OTA_URL_ENABLED=y
CONFIG_BLE_SRV_OTA_URL_SKIP_CERT_CHECK=n
CONFIG_BLE_SRV_OTA_URL_AUTO_UPDATE_ENABLED=y
CONFIG_BLE_SRV_NTP_ENABLED=y
CONFIG_BLE_SRV_LED_ENABLED=y

CONFIG_BLE_SRV_NTP_TIMEZONE="CST-8"
CONFIG_BLE_SRV_NTP_SERVER_1="ntp.aliyun.com"
CONFIG_BLE_SRV_NTP_SERVER_2="time1.aliyun.com"
CONFIG_BLE_SRV_NTP_SERVER_3="cn.ntp.org.cn"
CONFIG_BLE_SRV_NTP_SERVER_4="time.windows.com"
CONFIG_BLE_SRV_NTP_SERVER_5="pool.ntp.org"

# Log system - flash wear optimization
CONFIG_BLE_SRV_LOG_ENABLED=y
CONFIG_BLE_SRV_LOG_FLUSH_INTERVAL_MS=1000
CONFIG_BLE_SRV_LOG_FSYNC_EVERY_N_FLUSH=3

CONFIG_BT_ENABLED=y
CONFIG_BT_NIMBLE_ENABLED=y

# NimBLE memory pool from PSRAM
CONFIG_BT_NIMBLE_MEM_ALLOC_MODE_EXTERNAL=y

# BLE role: Peripheral only
CONFIG_BT_NIMBLE_ROLE_PERIPHERAL=y
CONFIG_BT_NIMBLE_ROLE_CENTRAL=n
CONFIG_BT_NIMBLE_ROLE_BROADCASTER=n
CONFIG_BT_NIMBLE_ROLE_OBSERVER=n
CONFIG_BT_NIMBLE_GATT_SERVER=y
CONFIG_BT_NIMBLE_GATT_CLIENT=n

# BLE connection parameters
CONFIG_BT_NIMBLE_MAX_BONDS=0
CONFIG_BT_NIMBLE_MAX_CONNECTIONS=1
CONFIG_BT_NIMBLE_MAX_CCCDS=4
CONFIG_BT_NIMBLE_MSYS_1_BLOCK_COUNT=6
CONFIG_BT_NIMBLE_MSYS_2_BLOCK_COUNT=12
CONFIG_BT_NIMBLE_TRANSPORT_ACL_FROM_LL_COUNT=8
CONFIG_BT_NIMBLE_TRANSPORT_EVT_COUNT=12
CONFIG_BT_NIMBLE_ATT_PREFERRED_MTU=512

# Disable standard GATT services (keep GAP only)
CONFIG_BT_NIMBLE_PROX_SERVICE=n
CONFIG_BT_NIMBLE_ANS_SERVICE=n
CONFIG_BT_NIMBLE_CTS_SERVICE=n
CONFIG_BT_NIMBLE_HTP_SERVICE=n
CONFIG_BT_NIMBLE_IPSS_SERVICE=n
CONFIG_BT_NIMBLE_TPS_SERVICE=n
CONFIG_BT_NIMBLE_IAS_SERVICE=n
CONFIG_BT_NIMBLE_LLS_SERVICE=n
CONFIG_BT_NIMBLE_SPS_SERVICE=n
CONFIG_BT_NIMBLE_HR_SERVICE=n
CONFIG_BT_NIMBLE_BAS_SERVICE=n
CONFIG_BT_NIMBLE_DIS_SERVICE=n
CONFIG_BT_NIMBLE_HID_SERVICE=n

CONFIG_PARTITION_TABLE_CUSTOM=y
CONFIG_PARTITION_TABLE_CUSTOM_FILENAME="partitions.csv"
CONFIG_PARTITION_TABLE_FILENAME="partitions.csv"

CONFIG_ESPTOOLPY_FLASHSIZE_4MB=y

CONFIG_WIFI_ENABLED=y
CONFIG_ESP_WIFI_STA_ENABLED=y
CONFIG_ESP_WIFI_AP_ENABLED=y
CONFIG_ESP_NETIF_ENABLED=y

# WiFi buffers
CONFIG_ESP_WIFI_STATIC_RX_BUFFER_NUM=4
CONFIG_ESP_WIFI_DYNAMIC_RX_BUFFER_NUM=16
CONFIG_ESP_WIFI_DYNAMIC_TX_BUFFER_NUM=16

# LWIP
CONFIG_LWIP_MAX_SOCKETS=4

CONFIG_MBEDTLS_CERTIFICATE_BUNDLE=y
CONFIG_MBEDTLS_DEFAULT_CERTIFICATE_BUNDLE=y

CONFIG_HTTPD_URI_MATCH_WILDCARD=y
```

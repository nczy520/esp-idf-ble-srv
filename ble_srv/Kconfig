## ble_srv/Kconfig
```kconfig
menu "BLE Service"

    config BLE_SRV_ENABLED
        bool "Enable BLE Service"
        default y
        help
            Enable BLE Service component for device management and OTA over BLE

    if BLE_SRV_ENABLED

    menu "Advertising"
        config BLE_SRV_ADV_NAME_PREFIX
            string "Device Name Prefix"
            default "BLE-SRV"
            help
                BLE device name prefix, full name will be prefix + last 3 bytes of MAC address

        config BLE_SRV_ADV_INTERVAL_MIN
            int "Advertising Interval Min (ms)"
            default 32
            help
                BLE advertising interval minimum in milliseconds (0x0020 = 32ms)

        config BLE_SRV_ADV_INTERVAL_MAX
            int "Advertising Interval Max (ms)"
            default 64
            help
                BLE advertising interval maximum in milliseconds (0x0040 = 64ms)
    endmenu

    menu "OTA Bluetooth"
        config BLE_SRV_OTA_BT_ENABLED
            bool "Enable Bluetooth OTA"
            default y
            help
                Enable firmware update via BLE GATT characteristics.

        config BLE_SRV_OTA_BT_NOTIFY_INTERVAL
            int "Progress Notify Interval (writes)"
            default 10
            help
                Number of firmware data writes between progress notifications.
                Smaller value = smoother progress bar but more BLE overhead.
                Larger value = less overhead but progress updates less frequently.
    endmenu

    menu "OTA URL"
        config BLE_SRV_OTA_URL_ENABLED
            bool "Enable URL OTA"
            default n
            depends on BLE_SRV_WIFI_ENABLED
            help
                Enable firmware update via HTTPS URL download. Requires WiFi connection.
                Before downloading, the device reads the firmware version from the
                remote binary header and compares it with the current version.
                Only downloads if the remote version is newer.

        config BLE_SRV_OTA_URL_DEFAULT
            string "Default Firmware URL"
            default ""
            depends on BLE_SRV_OTA_URL_ENABLED
            help
                Default firmware URL for URL OTA update.
                Can be overridden at runtime via BLE command.
                Example: https://example.com/firmware.bin

        config BLE_SRV_OTA_URL_SKIP_CERT_CHECK
            bool "Skip Certificate Common Name Check"
            default n
            depends on BLE_SRV_OTA_URL_ENABLED
            help
                Skip server certificate common name (CN) verification during HTTPS OTA.
                This disables ALL server-name authentication (CN/SAN/SNI).
                Only enable this for testing or when using self-signed certificates
                with incorrect hostname. Not recommended for production.

        config BLE_SRV_OTA_URL_ALLOW_DOWNGRADE
            bool "Allow Firmware Downgrade"
            default n
            depends on BLE_SRV_OTA_URL_ENABLED
            help
                Allow downgrading to an older firmware version during URL OTA.
                When disabled, OTA will be rejected if the remote firmware version
                is older than the current version. Enable this for testing or when
                you need to roll back to a previous version.

        config BLE_SRV_OTA_URL_AUTO_UPDATE_ENABLED
            bool "Auto OTA on WiFi Connect"
            default n
            depends on BLE_SRV_OTA_URL_ENABLED
            help
                Automatically check for firmware updates when WiFi connects.
                After WiFi connection, the device will:
                1. Sync NTP time (if NTP enabled)
                2. Check firmware version against the Default Firmware URL
                3. Download and apply update if a newer version is available
                Requires BLE_SRV_OTA_URL_DEFAULT to be configured.
    endmenu

    menu "WiFi"
        config BLE_SRV_WIFI_ENABLED
            bool "Enable WiFi Provisioner"
            default n
            help
                Enable WiFi provisioner using MichMich/esp-idf-wifi-provisioner
    endmenu

    menu "NTP"
        config BLE_SRV_NTP_ENABLED
            bool "Enable NTP Time Sync"
            default n
            depends on BLE_SRV_WIFI_ENABLED
            help
                Enable automatic NTP time synchronization after WiFi connection

        config BLE_SRV_NTP_TIMEZONE
            string "Timezone"
            default "CST-8"
            depends on BLE_SRV_NTP_ENABLED
            help
                Timezone string for NTP synchronization

        config BLE_SRV_NTP_SERVER_1
            string "NTP Server 1"
            default "ntp.aliyun.com"
            depends on BLE_SRV_NTP_ENABLED
            help
                Primary NTP server

        config BLE_SRV_NTP_SERVER_2
            string "NTP Server 2"
            default "time1.aliyun.com"
            depends on BLE_SRV_NTP_ENABLED
            help
                Secondary NTP server

        config BLE_SRV_NTP_SERVER_3
            string "NTP Server 3"
            default "cn.ntp.org.cn"
            depends on BLE_SRV_NTP_ENABLED
            help
                Tertiary NTP server

        config BLE_SRV_NTP_SERVER_4
            string "NTP Server 4"
            default "time.windows.com"
            depends on BLE_SRV_NTP_ENABLED
            help
                Fourth NTP server

        config BLE_SRV_NTP_SERVER_5
            string "NTP Server 5"
            default "pool.ntp.org"
            depends on BLE_SRV_NTP_ENABLED
            help
                Fifth NTP server
    endmenu

    menu "Authentication"
        config BLE_SRV_AUTH_ENABLED
            bool "Enable PIN Authentication"
            default n
            help
                Enable application-layer PIN authentication for BLE connections.
                When enabled, clients must write the correct PIN to the authentication
                characteristic before accessing other GATT characteristics.
                BLE connection is still open, but GATT operations require PIN verification.

        config BLE_SRV_AUTH_PIN
            string "Default PIN Code"
            default "123456"
            depends on BLE_SRV_AUTH_ENABLED
            help
                Default PIN code for BLE GATT authentication.
                PIN length must be between 1 and 16 characters.
                This can be changed at runtime via the authentication characteristic.
    endmenu

    menu "LED"
        config BLE_SRV_LED_ENABLED
            bool "Enable WS2812 LED Control"
            default n
            help
                Enable WS2812 RGB LED control via BLE.

        config BLE_SRV_LED_GPIO
            int "WS2812 LED GPIO Pin"
            default 21 if IDF_TARGET_ESP32S3
            default 10 if IDF_TARGET_ESP32C3 || IDF_TARGET_ESP32C6 || IDF_TARGET_ESP32H2
            default 18 if IDF_TARGET_ESP32S2
            default 2
            depends on BLE_SRV_LED_ENABLED
            help
                GPIO pin number for WS2812 LED data line.
                Default values per target: ESP32-S3=21, ESP32-C3/C6/H2=10, ESP32=2, ESP32-S2=18

        config BLE_SRV_LED_ROWS
            int "WS2812 LED Matrix Rows"
            default 1
            depends on BLE_SRV_LED_ENABLED
            help
                Number of rows in the WS2812 LED matrix.
                Set to 1 for single LED or linear strip.
                The total LED count is rows * cols.

        config BLE_SRV_LED_COLS
            int "WS2812 LED Matrix Columns"
            default 1
            depends on BLE_SRV_LED_ENABLED
            help
                Number of columns in the WS2812 LED matrix.
                Set to N for a linear strip of N LEDs (rows=1).
                The total LED count is rows * cols.
                Maximum allowed: 64 columns (use PSRAM for larger layouts).

        config BLE_SRV_LED_COUNT_MAX
            int "Maximum LED Count (buffer preallocation)"
            default 256
            depends on BLE_SRV_LED_ENABLED
            help
                Maximum number of LEDs supported for runtime layout changes.
                Frame and symbol buffers are preallocated based on this value.
                Actual active LED count is rows * cols (configurable at runtime).
    endmenu

    menu "Log System"
        config BLE_SRV_LOG_ENABLED
            bool "Enable Log System"
            default n
            help
                Enable log system that stores logs to LittleFS or SD card.
                Logs can be browsed and downloaded via HTTP server or BLE.

        config BLE_SRV_LOG_CONSOLE_ENABLED
            bool "Print logs to ESP-IDF console"
            default y
            depends on BLE_SRV_LOG_ENABLED
            help
                When enabled, BLE_SRV_LOGx macros will also output to the ESP-IDF
                console via ESP_LOGx. This replaces the need to call both ESP_LOGx
                and BLE_SRV_LOGx separately. Disable this to suppress console output
                and only persist logs to storage.

        config BLE_SRV_LOG_SD_ENABLED
            bool "Enable SD Card Support"
            default n
            depends on BLE_SRV_LOG_ENABLED
            help
                Enable SD card storage support for log system.
                When enabled, the log system will try to use SD card first.

        config BLE_SRV_LOG_SD_PATH
            string "SD Card Mount Path"
            default "/sdcard"
            depends on BLE_SRV_LOG_SD_ENABLED
            help
                Mount path for SD card storage.

        config BLE_SRV_LOG_LITTLEFS_PATH
            string "LittleFS Mount Path"
            default "/littlefs"
            depends on BLE_SRV_LOG_ENABLED
            help
                Mount path for LittleFS storage.

        config BLE_SRV_LOG_LITTLEFS_PARTITION
            string "LittleFS Partition Label"
            default "littlefs"
            depends on BLE_SRV_LOG_ENABLED
            help
                Partition label in partitions.csv for LittleFS storage.
                LittleFS component (joltwallet/littlefs) uses ESP_PARTITION_SUBTYPE_DATA_SPIFFS
                to find the partition, so the partition must have subtype 'spiffs'.

        config BLE_SRV_LOG_DIR
            string "Log Directory Name"
            default "/log"
            depends on BLE_SRV_LOG_ENABLED
            help
                Directory name under storage path for log files.

        config BLE_SRV_LOG_QUEUE_SIZE
            int "Log Queue Size (entries)"
            default 1024
            depends on BLE_SRV_LOG_ENABLED
            help
                Number of log entries that can be buffered in the queue.
                Queue storage is allocated from PSRAM, so large queues are fine.
                Larger queue reduces chance of log loss under heavy logging load.

        config BLE_SRV_LOG_LINE_SIZE
            int "Maximum Log Line Size (bytes)"
            default 512
            depends on BLE_SRV_LOG_ENABLED
            help
                Maximum size of a single log line in bytes.

        config BLE_SRV_LOG_FLUSH_INTERVAL_MS
            int "Flush Interval (ms)"
            default 1000
            depends on BLE_SRV_LOG_ENABLED
            help
                Interval in milliseconds between periodic log flushes to file.
                Smaller interval means more frequent writes but less data loss
                on crash. Larger interval is more efficient but risks more data loss.
                Default 1000ms balances flash wear and data safety.

        config BLE_SRV_LOG_FSYNC_EVERY_N_FLUSH
            int "fsync Every N Flushes"
            default 3
            depends on BLE_SRV_LOG_ENABLED
            help
                Call fsync (force physical write to flash) every N periodic
                flushes. Between fsync calls, only fflush (OS buffer flush) is
                used. Set to 1 to fsync on every flush (maximum durability,
                maximum wear). Set to 0 to disable periodic fsync entirely
                (fsync only on file rotation/deinit). Default 10.

        config BLE_SRV_LOG_MAX_FILES
            int "Maximum Log Files"
            default 50
            depends on BLE_SRV_LOG_ENABLED
            help
                Maximum number of log files to keep. When limit is reached,
                the oldest log file will be deleted automatically.

        config BLE_SRV_LOG_MIN_FREE_SPACE
            int "Minimum Free Space (KB)"
            default 256
            depends on BLE_SRV_LOG_ENABLED
            help
                Minimum free space in KB that must be available on the storage
                partition. Log system will not start if free space is below this
                threshold, and will delete oldest files to maintain it.

        config BLE_SRV_LOG_MAX_FILE_SIZE
            int "Maximum Log File Size (KB)"
            default 512
            depends on BLE_SRV_LOG_ENABLED
            help
                Maximum size of each log file in KB. When a log file exceeds
                this size, a new log file will be created automatically.

        config BLE_SRV_LOG_HTTP_PORT
            int "HTTP Server Port"
            default 8080
            depends on BLE_SRV_LOG_ENABLED
            help
                Port number for the log HTTP server. The server provides
                a web interface to browse and download log files.
    endmenu

    menu "Temperature Sensor"
        config BLE_SRV_TEMP_SENSOR_ENABLED
            bool "Enable Temperature Sensor"
            default y
            help
                Enable built-in temperature sensor reading.
                Supported chips: ESP32-S2, ESP32-S3, ESP32-C3, ESP32-C6, ESP32-H2, ESP32-P4.
                ESP32 does not have built-in temperature sensor.

        config BLE_SRV_TEMP_SENSOR_RANGE_MIN
            int "Temperature Range Min (°C)"
            default -10
            depends on BLE_SRV_TEMP_SENSOR_ENABLED
            help
                Minimum temperature range for the sensor in Celsius.

        config BLE_SRV_TEMP_SENSOR_RANGE_MAX
            int "Temperature Range Max (°C)"
            default 80
            depends on BLE_SRV_TEMP_SENSOR_ENABLED
            help
                Maximum temperature range for the sensor in Celsius.
    endmenu

    endif

endmenu
```
